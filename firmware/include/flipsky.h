#pragma once
// ─────────────────────────────────────────────────────────────────────────────
//  flipsky.h  —  Pilote UART natif pour ESC Flipsky FT85BS (non-VESC)
//  Protocole basé sur : FLIPSKY FTESC UART Protocol V1.6
//  Trame : [0xAA][LEN][payload...][CRC16_HI][CRC16_LO][0xDD]
// ─────────────────────────────────────────────────────────────────────────────
#include <Arduino.h>
#include <math.h>

// ── Commandes UART ────────────────────────────────────────────────────────────
#define FTESC_OBTAIN_DATA             0   // demander télémétrie (Input Signal Type: any)
#define FTESC_CONTROL_AND_OBTAIN      2   // contrôle + télémétrie (Input Signal Type: UART)
#define FTESC_SET_DUTY                3   // duty cycle    — seulement si IS_TYPE = OFF
#define FTESC_SET_CURRENT             4   // courant moteur — seulement si IS_TYPE = OFF
#define FTESC_SET_BRAKE_CURRENT       6   // courant frein  — seulement si IS_TYPE = OFF
#define FTESC_KEEP_ALIVE              25  // heartbeat

// Throttle pour cmd 02H
#define FTESC_THROTTLE_NEUTRAL  512   // 0 vitesse
#define FTESC_THROTTLE_MAX      1023  // pleine vitesse avant
#define FTESC_THROTTLE_MIN      0     // frein maximal

// Gear pour D6 de cmd 02H
#define FTESC_GEAR_NONE     0x00
#define FTESC_GEAR_LOW      0x01
#define FTESC_GEAR_MEDIUM   0x02
#define FTESC_GEAR_HIGH     0x03
#define FTESC_GEAR_REVERSE  0x04

// ── Structure données temps réel ──────────────────────────────────────────────
struct FlipskyData {
    uint8_t id;
    uint8_t fault;
    float   voltage;        // V
    float   inputCurrent;   // A
    float   motorCurrent;   // A
    float   rpm;
    float   duty;           // 0.0 – 1.0
    float   tempFet;        // °C
    float   tempMotor;      // °C
    float   cpuLoad;
};

// ── Tables CRC16 Modbus ───────────────────────────────────────────────────────
static const uint8_t _ftCrcHi[] = {
  0x00,0xC1,0x81,0x40,0x01,0xC0,0x80,0x41,0x01,0xC0,0x80,0x41,0x00,0xC1,0x81,0x40,
  0x01,0xC0,0x80,0x41,0x00,0xC1,0x81,0x40,0x00,0xC1,0x81,0x40,0x01,0xC0,0x80,0x41,
  0x01,0xC0,0x80,0x41,0x00,0xC1,0x81,0x40,0x00,0xC1,0x81,0x40,0x01,0xC0,0x80,0x41,
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  0x00,0xC1,0x81,0x40,0x01,0xC0,0x80,0x41,0x01,0xC0,0x80,0x41,0x00,0xC1,0x81,0x40
};
static const uint8_t _ftCrcLo[] = {
  0x00,0xC0,0xC1,0x01,0xC3,0x03,0x02,0xC2,0xC6,0x06,0x07,0xC7,0x05,0xC5,0xC4,0x04,
  0xCC,0x0C,0x0D,0xCD,0x0F,0xCF,0xCE,0x0E,0x0A,0xCA,0xCB,0x0B,0xC9,0x09,0x08,0xC8,
  0xD8,0x18,0x19,0xD9,0x1B,0xDB,0xDA,0x1A,0x1E,0xDE,0xDF,0x1F,0xDD,0x1D,0x1C,0xDC,
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  0x44,0x84,0x85,0x45,0x87,0x47,0x46,0x86,0x82,0x42,0x43,0x83,0x41,0x81,0x80,0x40
};

// ── CRC16 ─────────────────────────────────────────────────────────────────────
inline uint16_t ftesc_crc16(const uint8_t *buf, uint16_t len) {
    uint8_t hi = 0xFF, lo = 0xFF;
    while (len--) {
        uint8_t idx = lo ^ *buf++;
        lo = hi ^ _ftCrcHi[idx];
        hi = _ftCrcLo[idx];
    }
    return (uint16_t)(hi << 8 | lo);
}

// ── Décodeurs ─────────────────────────────────────────────────────────────────
inline int16_t _i16(const uint8_t *d, int32_t *i) {
    int16_t v = (int16_t)(((uint16_t)d[*i] << 8) | d[*i+1]);
    *i += 2; return v;
}
inline int32_t _i32(const uint8_t *d, int32_t *i) {
    int32_t v = ((uint32_t)d[*i]<<24)|((uint32_t)d[*i+1]<<16)|
                ((uint32_t)d[*i+2]<<8)|(uint32_t)d[*i+3];
    *i += 4; return v;
}
inline float _f16(const uint8_t *d, float mult, int32_t *i) { return (float)_i16(d,i)/mult; }
inline float _f32(const uint8_t *d, float mult, int32_t *i) { return (float)_i32(d,i)/mult; }

// ── Encodeurs ─────────────────────────────────────────────────────────────────
inline void _put_i16(uint8_t *d, int32_t *i, int16_t v) {
    d[(*i)++] = v >> 8; d[(*i)++] = v & 0xFF;
}
inline void _put_i32(uint8_t *d, int32_t *i, int32_t v) {
    d[(*i)++] = v>>24; d[(*i)++] = v>>16; d[(*i)++] = v>>8; d[(*i)++] = v;
}

// ── Envoi d'un paquet ─────────────────────────────────────────────────────────
inline void ftesc_send(HardwareSerial &uart, const uint8_t *payload, uint8_t len) {
    uint8_t buf[64];
    int i = 0;
    uint16_t crc = ftesc_crc16(payload, len);
    buf[i++] = 0xAA;
    buf[i++] = len;
    memcpy(&buf[i], payload, len); i += len;
    buf[i++] = crc >> 8;
    buf[i++] = crc & 0xFF;
    buf[i++] = 0xDD;
    uart.write(buf, i);
}

// ── Commandes vers l'ESC ──────────────────────────────────────────────────────

// Télémétrie seule (fonctionne quel que soit le mode)
inline void ftesc_requestData(HardwareSerial &uart) {
    uint8_t p[1] = { FTESC_OBTAIN_DATA };
    ftesc_send(uart, p, 1);
}

// ── Commande principale en mode UART (Input Signal Type = UART) ───────────────
// throttle : FTESC_THROTTLE_MIN(0)=frein max … FTESC_THROTTLE_NEUTRAL(512)=stop …
//            FTESC_THROTTLE_MAX(1023)=pleine vitesse
// gear     : FTESC_GEAR_HIGH (03H) par défaut
// brake_light: true pour allumer le feu de frein
inline void ftesc_control(HardwareSerial &uart, uint16_t throttle,
                          uint8_t gear = FTESC_GEAR_HIGH,
                          bool brake_light = false) {
    uint8_t p[15];
    int32_t i = 0;
    p[i++] = FTESC_CONTROL_AND_OBTAIN; // CMD = 0x02
    p[i++] = 0x00; p[i++] = 0x00;     // D0 D1: Reserved
    p[i++] = (uint8_t)(throttle >> 8); // D2: throttle hi
    p[i++] = (uint8_t)(throttle);      // D3: throttle lo
    p[i++] = 0x00;                     // D4: direction switching disabled
    p[i++] = 0x00;                     // D5: forward
    p[i++] = gear;                     // D6: speed gear
    p[i++] = 0x00;                     // D7: horn off
    p[i++] = 0x00;                     // D8: headlight off
    p[i++] = brake_light ? 0x01 : 0x00; // D9: brake light
    p[i++] = 0x00;                     // D10: cruise disabled
    p[i++] = 0x00;                     // D11: exit cruise
    p[i++] = 0x00;                     // D12: multi-mode disabled
    p[i++] = 0x00;                     // D13: normal control
    ftesc_send(uart, p, 15);
}

// ── Réception et décodage ─────────────────────────────────────────────────────
// Appeler dans loop() — retourne true si une trame complète a été décodée
inline bool ftesc_poll(HardwareSerial &uart, FlipskyData &out) {
    static uint8_t rxBuf[128];
    static uint8_t rxLen = 0;
    static uint32_t lastByte = 0;

    // Reset si timeout inter-octets > 50 ms
    if (rxLen > 0 && millis() - lastByte > 50) rxLen = 0;

    while (uart.available()) {
        rxBuf[rxLen++] = uart.read();
        lastByte = millis();
        if (rxLen >= sizeof(rxBuf)) rxLen = 0;
    }

    // Chercher une trame complète : 0xAA + LEN + payload + CRC(2) + 0xDD
    if (rxLen < 5) return false;
    if (rxBuf[0] != 0xAA) { rxLen = 0; return false; } // mauvais header

    uint8_t dataLen = rxBuf[1];
    uint8_t frameLen = 2 + dataLen + 3; // AA + LEN + data + CRC(2) + DD
    if (rxLen < frameLen) return false;

    // Vérifier footer
    if (rxBuf[frameLen - 1] != 0xDD) { rxLen = 0; return false; }

    // Vérifier CRC
    const uint8_t *data = rxBuf + 2;
    uint16_t crcCalc = ftesc_crc16(data, dataLen);
    uint16_t crcRecv = ((uint16_t)data[dataLen] << 8) | data[dataLen + 1];
    if (crcCalc != crcRecv) { rxLen = 0; return false; }

    // Décoder selon la commande
    uint8_t cmd = data[0];
    int32_t idx = 1; // après le byte de commande
    bool decoded = false;

    if (cmd == FTESC_OBTAIN_DATA) {
        // Réponse 00H : ID + FAULT + données
        out.id           = data[idx++];
        out.fault        = data[idx++];
        out.voltage      = _f16(data, 100.0f,     &idx);
        out.inputCurrent = _f32(data, 1000000.0f, &idx);
        out.motorCurrent = _f32(data, 1000000.0f, &idx);
        out.rpm          = _f32(data, 1.0f,        &idx);
        out.duty         = _f16(data, 10000.0f,   &idx);
        out.tempFet      = _f16(data, 100.0f,     &idx);
        out.tempMotor    = _f16(data, 100.0f,     &idx);
        out.cpuLoad      = _f16(data, 10000.0f,   &idx);
        decoded = true;
    } else if (cmd == FTESC_CONTROL_AND_OBTAIN) {
        // Réponse 02H : FAULT + données (pas de ID)
        out.id           = 0;
        out.fault        = data[idx++];
        out.voltage      = _f16(data, 100.0f,     &idx);
        out.inputCurrent = _f32(data, 1000000.0f, &idx);
        out.motorCurrent = _f32(data, 1000000.0f, &idx);
        out.rpm          = _f32(data, 1.0f,        &idx);
        out.duty         = _f16(data, 10000.0f,   &idx);
        out.tempFet      = _f16(data, 100.0f,     &idx);
        out.tempMotor    = _f16(data, 100.0f,     &idx);
        out.cpuLoad      = _f16(data, 10000.0f,   &idx);
        decoded = true;
    }

    // Consommer la trame du buffer
    rxLen -= frameLen;
    if (rxLen > 0) memmove(rxBuf, rxBuf + frameLen, rxLen);

    return decoded;
}
